typedef struct timeStamp{
  timeStamp* next;  
  int stamp;
  int fingOn;
  int fingOff;
}timeStamp;

typedef struct handPos{
  handPos* moveNext;
  timeStamp* next;
  int pos;
}handPos;

const int fing[8] = {22,24,26,28,30,32,34,36};

int arr[]={1600,1,71,1600,1,64,1600,1,67,1900,0,71,1900,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0,71};
int i=0;
int j=0;
int numElements=(sizeof(arr)/sizeof(arr[0]));
int timeStart;

typedef struct timeStamp *node;
node start=NULL;
node visit=NULL;

void setup() {
  // put your setup code here, to run once:
  Serial.begin(9600);
  pinMode(fing[0], OUTPUT);
  pinMode(fing[1], OUTPUT);
  pinMode(fing[2], OUTPUT);
  pinMode(fing[3], OUTPUT);
  pinMode(fing[4], OUTPUT);
  pinMode(fing[5], OUTPUT);
  pinMode(fing[6], OUTPUT);
  pinMode(fing[7], OUTPUT);
  for(i=0;i<numElements;i=i+3){
  start=addTimeStamp(start,arr,i);
  Serial.print(start->fingOn);
  }
  visit=start;
  timeStart = millis();
}

void loop() {
  // put your main code here, to run repeatedly:
  while(visit!=NULL){
  Serial.print(visit->stamp);
  Serial.print("\n");
  i=visit->fingOn;
  Serial.print(i);
  Serial.print("\n");
  //sends voltage to the fingers
  while (millis() < (visit -> stamp)) {
  }
  if(visit -> fingOn != 0) {
    digitalWrite(fing[(visit -> fingOn) - 60], HIGH);
  }
  if(visit -> fingOff != 0) {
    digitalWrite(fing[(visit -> fingOff) - 60], LOW);
  }
visit=visit->next;
  }
}

node createNode(){
  node temp;
  temp=(node)malloc(sizeof(timeStamp));
  temp->next=NULL;
  return temp;
}

node addTimeStamp(node start, int arr[],int i){
  int j=0;
  int k=0;
  node temp=NULL;
  node point=NULL;
  temp=createNode();
  temp->stamp=arr[i];
  if(arr[i+1]==0){
  temp->fingOff=arr[i+2];
  Serial.print(temp->fingOff);
  temp->fingOn=0;
  Serial.print(temp->fingOn);
  }
  else if(arr[i+1]==1){
  temp->fingOn=arr[i+2];
  Serial.print(temp->fingOn);
  temp->fingOff=0;
  Serial.print(temp->fingOff);
  }
  if(start==NULL){
  start=temp;
  }
  else{
  point=start;
  while(point->next!=NULL){
    point=point->next;
  }
  point->next=temp;
  }
  return start;
}
